#define CUSTOM_SHIFT_WITH_CANCEL(NAME, BINDING, SHIFT_BINDING) \
/ { \
  behaviors { \
    NAME ## _shift: NAME ## _shift { \
      compatible = "zmk,behavior-mod-morph"; \
      label = U_STRINGIFY(NAME ## _shift); \
      #binding-cells = <0>; \
      bindings = <BINDING>, <SHIFT_BINDING>; \
      mods = <(MOD_LSFT|MOD_RSFT)>; \
    }; \
    NAME: NAME { \
      compatible = "zmk,behavior-mod-morph"; \
      label = U_STRINGIFY(NAME); \
      #binding-cells = <0>; \
      bindings = <& ## NAME ## _shift>, <BINDING>; \
      mods = <(MOD_LCTL|MOD_RCTL|MOD_LALT|MOD_RALT|MOD_LGUI|MOD_RGUI)>; \
      keep-mods = <(MOD_LCTL|MOD_RCTL|MOD_LALT|MOD_RALT|MOD_LGUI|MOD_RGUI)>; \
    }; \
  }; \
};

CUSTOM_SHIFT_WITH_CANCEL(dot_rpar, &kp DOT, &kp RPAR)
CUSTOM_SHIFT_WITH_CANCEL(comma_lpar, &kp COMMA, &kp LPAR)

/ {
  combos {
    compatible = "zmk,combos";
    combo_caps_word {
      timeout-ms = <50>;
      key-positions = <16 19>;
      layers = <0>;
      bindings = <&caps_word>;
    };
  };
};